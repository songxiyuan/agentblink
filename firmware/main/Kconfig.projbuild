## firmware/main/Kconfig.projbuild
```kconfig
menu "Example Configuration"

    orsource "$IDF_PATH/examples/common_components/env_caps/$IDF_TARGET/Kconfig.env_caps"

    choice BLINK_LED
        prompt "Blink LED type"
        default BLINK_LED_GPIO
        help
            Select the LED type. A normal level controlled LED or an addressable LED strip.
            The default selection is based on the Espressif DevKit boards.
            You can change the default selection according to your board.

        config BLINK_LED_GPIO
            bool "GPIO"
        config BLINK_LED_STRIP
            bool "LED strip"
    endchoice

    choice BLINK_LED_STRIP_BACKEND
        depends on BLINK_LED_STRIP
        prompt "LED strip backend peripheral"
        default BLINK_LED_STRIP_BACKEND_RMT if SOC_RMT_SUPPORTED
        default BLINK_LED_STRIP_BACKEND_SPI
        help
            Select the backend peripheral to drive the LED strip.

        config BLINK_LED_STRIP_BACKEND_RMT
            depends on SOC_RMT_SUPPORTED
            bool "RMT"
        config BLINK_LED_STRIP_BACKEND_SPI
            bool "SPI"
    endchoice

    config BLINK_GPIO
        int "Blink GPIO number"
        range ENV_GPIO_RANGE_MIN ENV_GPIO_OUT_RANGE_MAX
        default 8
        help
            GPIO number (IOxx) to blink on and off the LED.
            Some GPIOs are used for other purposes (flash connections, etc.) and cannot be used to blink.

    config BLINK_PERIOD
        int "Blink period in ms"
        range 10 3600000
        default 1000
        help
            Define the blinking period in milliseconds.

    config BUZZER_ENABLE
        bool "Enable passive buzzer"
        default y
        help
            Enable PWM control for a passive buzzer.

    config BUZZER_GPIO
        int "Passive buzzer GPIO number"
        depends on BUZZER_ENABLE
        range ENV_GPIO_RANGE_MIN ENV_GPIO_OUT_RANGE_MAX
        default 4
        help
            GPIO number connected to the passive buzzer signal input.

    config BUZZER_DUTY_PERCENT
        int "Passive buzzer duty percent"
        depends on BUZZER_ENABLE
        range 1 90
        default 50
        help
            PWM duty cycle used by beep commands. 50 percent is typical for passive buzzers.

    config SOLID_BUZZER_FREQUENCY_HZ
        int "Solid command buzzer frequency in Hz"
        depends on BUZZER_ENABLE
        range 20 20000
        default 2000
        help
            Frequency played by the passive buzzer when the solid command sets all LEDs.

    config SOLID_BUZZER_DURATION_MS
        int "Solid command buzzer duration in ms"
        depends on BUZZER_ENABLE
        range 0 10000
        default 1000
        help
            Buzzer duration after a solid color command. Set to 0 to disable the solid command beep.

    config VIBRATION_MOTOR_ENABLE
        bool "Enable vibration motor"
        default y
        help
            Enable GPIO level control for a vibration motor through a transistor or driver.

    config VIBRATION_MOTOR_GPIO
        int "Vibration motor GPIO number"
        depends on VIBRATION_MOTOR_ENABLE
        range ENV_GPIO_RANGE_MIN ENV_GPIO_OUT_RANGE_MAX
        default 3
        help
            GPIO number connected to the vibration motor driver signal input.

endmenu
```
